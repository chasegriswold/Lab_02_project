# file: Lab_02_project.ioc
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Mcu.Family=STM32F0
Mcu.Name=STM32F072R(8-B)Tx
Mcu.Package=LQFP64
ProjectManager.HeapSize=0x200
ProjectManager.StackSize=0x400
ProjectManager.TargetToolchain=MDK-ARM V5.32
board=custom

// file: Core/Src/main.c
/* USER CODE BEGIN Header */
/**
  ******************************************************************************
  * @file           : main.c
  * @brief          : Main program body
  ******************************************************************************
  * @attention
  *
  * Copyright (c) 2024 STMicroelectronics.
  * All rights reserved.
  *
  * This software is licensed under terms that can be found in the LICENSE file
  * in the root directory of this software component.
  * If no LICENSE file comes with this software, it is provided AS-IS.
  *
  ******************************************************************************
  */
/* USER CODE END Header */
#include "main.h"

void SystemClock_Config(void);

int main(void) {

	HAL_Init(); // Reset of all peripherals, init the Flash interface and Systick
	SystemClock_Config(); //Configure the system clock

	//RED is 6, BLUE is 7, ORANGE is 8, GREEN is 9

__HAL_RCC_GPIOC_CLK_ENABLE(); // Enable the GPIOC clock in the RCC
	// Set up a configuration struct to pass to the initialization function
	GPIO_InitTypeDef initStr = {GPIO_PIN_6 | GPIO_PIN_7 | GPIO_PIN_8 | GPIO_PIN_9,
	GPIO_MODE_OUTPUT_PP,
	GPIO_SPEED_FREQ_LOW,
	GPIO_NOPULL};
	HAL_GPIO_Init(GPIOC, &initStr); // Initialize pins PC8 & PC9
	HAL_GPIO_WritePin(GPIOC, GPIO_PIN_9, GPIO_PIN_SET); // Start PC8 high

	/* Set PA0 to input mode (bits 0 and 1 of GPIOA) On*/
	GPIOA->MODER = 0x28000000; // This is the reset state for GPIOA datasheet page 158
	// the above code is a cleaner way to set it to input mode. The datasheet calls out bits 0 and 1 both be set to 0 for input mode, but above code accomplishes the same thing.

	//Set the pins to low speed
	GPIOA->OSPEEDR &= ~(1<<0); // Sets the 0th bit = 0 -- NOTE: Next bit is a don't care

	//Enable the pull-down resistor --
	GPIOA->PUPDR |= 2; // Since pull down is 10 for bits 1 and 0 respectively (2 in decimal) we can just set this register to = 2.

	//set up interrupt on EXTI line 0
	EXTI->IMR |= EXTI_IMR_MR0_Msk;

	//Set rising edge trigger
	EXTI->RTSR |= (1<< 0);

	//SYSCFG Clock
	RCC->APB2ENR |= RCC_APB2ENR_SYSCFGCOMPEN_Msk;

	//Ensure PA0 routes to SYSCFG
	SYSCFG->EXTICR[0] &= ~(7 << 0);

	//Enable in NVIC
	NVIC_EnableIRQ(EXTI0_1_IRQn);
	NVIC_SetPriority(EXTI0_1_IRQn, 3); // Change the priority to 1 to starve Systick, to 3 to allow Systick

	NVIC_SetPriority(SysTick_IRQn, 2);

	while (1) {
		HAL_Delay(600); // Delay 600ms
		// Toggle the output state of both PC8 and PC9
		HAL_GPIO_TogglePin(GPIOC, GPIO_PIN_6);
	}

	  /* Reset of all peripherals, Initializes the Flash interface and the Systick. */

  /* Initialize all configured peripherals */

  /* Infinite loop */
  /* USER CODE BEGIN WHILE */
  while (1)
  {
		GPIOC->BSRR = (1<<6);
		HAL_Delay(500); //500 ms delay
		GPIOC->BSRR = (1<<22);
		HAL_Delay(500); //500 ms delay

  }

  /* USER CODE END 3 */
}

void SystemClock_Config(void)
{
  RCC_OscInitTypeDef RCC_OscInitStruct = {0};
  RCC_ClkInitTypeDef RCC_ClkInitStruct = {0};

  /** Initializes the RCC Oscillators according to the specified parameters
  * in the RCC_OscInitTypeDef structure.
  */
  RCC_OscInitStruct.OscillatorType = RCC_OSCILLATORTYPE_HSI;
  RCC_OscInitStruct.HSIState = RCC_HSI_ON;
  RCC_OscInitStruct.HSICalibrationValue = RCC_HSICALIBRATION_DEFAULT;
  RCC_OscInitStruct.PLL.PLLState = RCC_PLL_NONE;
  if (HAL_RCC_OscConfig(&RCC_OscInitStruct) != HAL_OK)
  {
    Error_Handler();
  }

  /** Initializes the CPU, AHB and APB buses clocks
  */
  RCC_ClkInitStruct.ClockType = RCC_CLOCKTYPE_HCLK|RCC_CLOCKTYPE_SYSCLK
                              |RCC_CLOCKTYPE_PCLK1;
  RCC_ClkInitStruct.SYSCLKSource = RCC_SYSCLKSOURCE_HSI;
  RCC_ClkInitStruct.AHBCLKDivider = RCC_SYSCLK_DIV1;
  RCC_ClkInitStruct.APB1CLKDivider = RCC_HCLK_DIV1;

  if (HAL_RCC_ClockConfig(&RCC_ClkInitStruct, FLASH_LATENCY_0) != HAL_OK)
  {
    Error_Handler();
  }
}

/* USER CODE BEGIN 4 */

void EXTI0_1_IRQHandler(void)
{

	volatile int count = 0;

	GPIOC->ODR ^= (1<<8);
	GPIOC->ODR ^= (1<<9);

	while(count < 1500000)
		count++;

	GPIOC->ODR ^= (1<<8);
	GPIOC->ODR ^= (1<<9);
	//EXTI->PR |= (1<<0);

	EXTI->PR = EXTI_PR_PR0; /* clear exti line 0 flag */
}

/* USER CODE END 4 */

void Error_Handler(void)
{
  __disable_irq();
  while (1)
  {
  }
}
